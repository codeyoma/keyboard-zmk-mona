## Kconfig
```kconfig
# Options for the code in this repository (see zephyr/module.yml).

config ZMK_MOUSE_SPEED
    bool "Mouse key speed levels (&mouse_speed)"
    default y
    depends on DT_HAS_ZMK_BEHAVIOR_MOUSE_SPEED_ENABLED
    depends on ZMK_POINTING
    depends on !ZMK_SPLIT || ZMK_SPLIT_ROLE_CENTRAL

if ZMK_MOUSE_SPEED

config ZMK_MOUSE_SPEED_LEVELS
    int "Number of mouse key speed levels"
    default 4
    help
      The CPI of each level is set by the cpi-levels of the input processor.

config ZMK_MOUSE_SPEED_DEFAULT_LEVEL
    int "Mouse key speed level before any level has been saved"
    default 2

endif
```

## config/boards/shields/mona2/Kconfig.shield
```kconfig
config SHIELD_MONA2_L
    def_bool $(shields_list_contains,mona2_l)

config SHIELD_MONA2_R
    def_bool $(shields_list_contains,mona2_r)
```

## dts/bindings/behaviors/zmk,behavior-mouse-speed.yaml
```yaml
description: |
  Steps a trackball speed level (src/mouse_speed.c), wrapping back to the first level.
  The parameter picks the set: 0 for the normal levels, 1 for the sniping levels.

compatible: "zmk,behavior-mouse-speed"

include: one_param.yaml
```

## dts/bindings/input_processors/zmk,input-processor-mouse-speed.yaml
```yaml
description: |
  Turns sensor counts into the CPI of the current speed level (src/mouse_speed.c). The
  parameter is 0 for the current normal level (cpi-levels), 1 for the current sniping level
  (snipe-cpi-levels).

compatible: "zmk,input-processor-mouse-speed"

include: ip_one_param.yaml

properties:
  type:
    type: int
    required: true
  codes:
    type: array
    required: true
  sensor-cpi:
    type: int
    required: true
    description: The CPI the sensor reports at (its res-cpi)
  cpi-levels:
    type: array
    required: true
    description: The CPI of each speed level, slowest first
  snipe-cpi-levels:
    type: array
    required: true
    description: The CPI of each sniping level, slowest first
```
